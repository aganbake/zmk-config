## config/boards/shields/hans/Kconfig.defconfig
```kconfig
# Copyright (c) 2020 The ZMK Contributors
# SPDX-License-Identifier: MIT

if SHIELD_HANS_RIGHT

config ZMK_KEYBOARD_NAME
	default "Hans Corne"

config ZMK_SPLIT_BLE_ROLE_CENTRAL
	default y

endif

if SHIELD_HANS_LEFT || SHIELD_HANS_RIGHT

config ZMK_SPLIT
	default y

endif
```

## config/boards/shields/hans/Kconfig.shield
```kconfig
# Copyright (c) 2020 The ZMK Contributors
# SPDX-License-Identifier: MIT

config SHIELD_FIVE_LEFT
	def_bool $(shields_list_contains,hans_left)

config SHIELD_FIVE_RIGHT
	def_bool $(shields_list_contains,hans_right)
```

## config/west.yml
```yaml
manifest:
  remotes:
    - name: zmkfirmware
      url-base: https://github.com/cdc-mkb/zmk/tree/mouse-pim447
  projects:
    - name: zmk
      remote: zmkfirmware
      revision: main
      import: app/west.yml
  self:
    path: config
```
